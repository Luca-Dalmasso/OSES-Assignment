## conf/layer.conf
```bitbake
# We have a conf and classes directory, add to BBPATH
BBPATH .= ":${LAYERDIR}"

# We have recipes-* directories, add to BBFILES
BBFILES += "${LAYERDIR}/recipes-*/*/*.bb \
            ${LAYERDIR}/recipes-*/*/*.bbappend"

BBFILE_COLLECTIONS += "assign-kernel-layer"
BBFILE_PATTERN_assign-kernel-layer = "^${LAYERDIR}/"
BBFILE_PRIORITY_assign-kernel-layer = "6"

LAYERDEPENDS_assign-kernel-layer = "core"
LAYERSERIES_COMPAT_assign-kernel-layer = "dunfell"
```
